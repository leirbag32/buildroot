## package/gfxstream/Config.in
```kconfig
config BR2_PACKAGE_GFXSTREAM
	bool "gfxstream"
	depends on BR2_INSTALL_LIBSTDCPP
	depends on BR2_TOOLCHAIN_HAS_THREADS
	depends on BR2_TOOLCHAIN_USES_GLIBC # required by prebuilt/upstream assumptions
	depends on !BR2_STATIC_LIBS # dlopen / shared libraries
	select BR2_PACKAGE_LIBDRM
	select BR2_PACKAGE_LIBAEMU
	select BR2_PACKAGE_VULKAN_HEADERS
	select BR2_PACKAGE_VULKAN_LOADER
	help
	  Graphics Streaming Kit (gfxstream) for forwarding OpenGL ES
	  and Vulkan calls from a virtual machine guest to a host.

	  https://googlesource.com

comment "gfxstream needs a glibc toolchain w/ C++, threads, dynamic library"
	depends on !BR2_INSTALL_LIBSTDCPP || !BR2_TOOLCHAIN_HAS_THREADS || \
		!BR2_TOOLCHAIN_USES_GLIBC || BR2_STATIC_LIBS
```

## package/libaemu/Config.in
```kconfig
config BR2_PACKAGE_LIBAEMU
	bool "libaemu"
	depends on BR2_INSTALL_LIBSTDCPP
	depends on BR2_TOOLCHAIN_HAS_THREADS
	depends on BR2_TOOLCHAIN_USES_GLIBC
	depends on !BR2_STATIC_LIBS
	select BR2_PACKAGE_LZ4
	help
	  Android Emulator (AEMU) common utility libraries, including
	  aemu-base, aemu-host-common, and aemu-logging required by
	  gfxstream.

	  https://googlesource.com

comment "libaemu needs a glibc toolchain w/ C++, threads, dynamic library"
	depends on !BR2_INSTALL_LIBSTDCPP || !BR2_TOOLCHAIN_HAS_THREADS || \
		!BR2_TOOLCHAIN_USES_GLIBC || BR2_STATIC_LIBS
```

## package/rutabaga-gfx-ffi/Config.in
```kconfig
config BR2_PACKAGE_RUTABAGA_GFX_FFI
	bool "rutabaga_gfx_ffi"
	depends on BR2_PACKAGE_HOST_RUSTC_TARGET_ARCH_SUPPORTS
	select BR2_PACKAGE_HOST_RUSTC
	select BR2_PACKAGE_GFXSTREAM
	select BR2_PACKAGE_LIBDRM
	help
	  C FFI bindings for rutabaga_gfx (virtio-gpu / gfxstream
	  virtualization library from crosvm).

	  https://googlesource.com
```
